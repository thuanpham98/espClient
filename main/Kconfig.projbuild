## main/Kconfig.projbuild
```kconfig
menu "Example configuration"

	config WIFI_SSID
		string "wifi SSID"
		default "AuCo_Tret1a"
		help
			Enter the SSID of the wifi network

	config WIFI_PASSWORD
		string "Wifi password"
		default "999999999"
		help
			Enter the password of the wifi network

	config MAXIMUM_RETRY
		int "100"
		default 100
		help
			Enter the max time retry

	config MAX_HTTP_RECV_BUFFER
		int "512"
		default 512
		help
			Enter the max memory in byte for buffer receive

	config ID_DEVICE
		string "ID in email"
		default "1583296319374"
		help
			Enter the ID

	config NUMBER_DEVICE
		int "NUMBER OPEN DEVICE"
		default 0
		help
			Enter the NUMBER DEVIDE

	config URL_SERVER
		string "Stored"
		default "http://192.168.1.10:6969/storage"
		help
			Enter the URL

endmenu
```
